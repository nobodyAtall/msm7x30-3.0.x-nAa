## drivers/video/msm/mddi_nt_panels/Kconfig
```kconfig
#
# Extracted panels which will be connected to the MDDI Novatek MCU
#

menu "Extracted panels which will be connected to the MDDI Novatek MCU"

config MDDI_NOVATEK_PANEL_TMD_MDP42
	depends on FB_MSM_MDDI_NOVATEK_FWVGA
	bool "TMD MDP42 Panel"
	default n
	---help---
	  Support for TMD MDP42 panel connected
	  to the MDDI Novatek micro controller

config MDDI_NOVATEK_PANEL_SHARP_LS040T8LX01
	depends on FB_MSM_MDDI_NOVATEK_FWVGA
	bool "SHARP LS040T8LX01 Panel"
	default n
	---help---
	  Support for SHARP LS040T8LX01 panel connected
	  to the MDDI Novatek micro controller

config MDDI_NOVATEK_PANEL_SHARP_LS042T3LX
	depends on FB_MSM_MDDI_NOVATEK_FWVGA
	bool "SHARP LS042T3LX Panel"
	default n
	---help---
	  Support for SHARP_LS042T3LX panel connected
	  to the MDDI Novatek micro controller

config MDDI_NOVATEK_PANEL_SONY_ACX424AKM
	depends on FB_MSM_MDDI_NOVATEK_FWVGA
	bool "SONY ACX424AKM Panel"
	default n
	---help---
	  Support for SONY_ACX424AKM panel connected
	  to the MDDI Novatek micro controller

config MDDI_NOVATEK_PANEL_SONY_ACX427AK
	depends on FB_MSM_MDDI_NOVATEK_FWVGA
	bool "SONY ACX427AK Panel"
	default n
	---help---
	  Support for SONY_ACX427AK panel connected
	  to the MDDI Novatek micro controller

config MDDI_NOVATEK_PANEL_SONY_ACX424AK
	depends on FB_MSM_MDDI_NOVATEK_FWVGA
	bool "SONY ACX424AK Panel"
	default n
	---help---
	  Support for SONY_ACX424AK panel connected
	  to the MDDI Novatek micro controller

config MDDI_NOVATEK_PANEL_HITACHI_DX09D09VM
	depends on FB_MSM_MDDI_NOVATEK_FWVGA
	bool "HITACHI DX09D09VM Panel"
	default n
	---help---
	  Support for HITACHI_DX09D09VM panel connected
	  to the MDDI Novatek micro controller

config MDDI_NOVATEK_PANEL_SHARP_LS033T3LX01
	depends on FB_MSM_MDDI_NOVATEK_FWVGA
	bool "SHARP LS033T3LX01 Panel"
	default n
	---help---
	  Support for SHARP_LS033T3LX01 panel connected
	  to the MDDI Novatek micro controller

config MDDI_NOVATEK_PANEL_TMD_LT033MDV1000
	depends on FB_MSM_MDDI_NOVATEK_FWVGA
	bool "TMD LT033MDV1000 Panel"
	default n
	---help---
	  Support for TMD_LT033MDV1000 panel connected
	  to the MDDI Novatek micro controller
endmenu
```
